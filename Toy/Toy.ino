static const char PROGMEM eye[]={
  0x00, 0x00, 0x00, 0x00, 0x00, 0x0f, 0xe0, 0x00, 0x00, 0x7f, 0xfc, 0x00, 0x01, 0xff, 0xff, 0x00, 
  0x03, 0xff, 0xff, 0x80, 0x07, 0xff, 0xff, 0xc0, 0x0f, 0xff, 0xff, 0xe0, 0x1f, 0xff, 0xff, 0xf0, 
  0x1f, 0xff, 0xff, 0xf0, 0x3f, 0xff, 0xff, 0xf8, 0x3f, 0xff, 0xff, 0xf8, 0x3f, 0xff, 0xff, 0xf8, 
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  0x00, 0x7f, 0xfc, 0x00, 0x00, 0x0f, 0xe0, 0x00, 0x00, 0x00, 0x00, 0x00, 0x00, 0x00, 0x00, 0x00
};

static const char PROGMEM eye1[]={
  0x00, 0x00, 0x00, 0x00, 0x00, 0x00, 0x00, 0x00, 0x00, 0x00, 0x00, 0x00, 0x00, 0x00, 0x00, 0x00, 
  0x00, 0x00, 0x00, 0x00, 0x07, 0xff, 0xff, 0xc0, 0x0f, 0xff, 0xff, 0xe0, 0x1f, 0xff, 0xff, 0xf0, 
  0x1f, 0xff, 0xff, 0xf0, 0x3f, 0xff, 0xff, 0xf8, 0x3f, 0xff, 0xff, 0xf8, 0x3f, 0xff, 0xff, 0xf8, 
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  0x00, 0x00, 0x00, 0x00, 0x00, 0x00, 0x00, 0x00, 0x00, 0x00, 0x00, 0x00, 0x00, 0x00, 0x00, 0x00
};

static const char PROGMEM eye2[]={
  0x00, 0x00, 0x00, 0x00, 0x00, 0x00, 0x00, 0x00, 0x00, 0x00, 0x00, 0x00, 0x00, 0x00, 0x00, 0x00, 
  0x00, 0x00, 0x00, 0x00, 0x00, 0x00, 0x00, 0x00, 0x00, 0x00, 0x00, 0x00, 0x00, 0x00, 0x00, 0x00, 
  0x00, 0x00, 0x00, 0x00, 0x3f, 0xff, 0xff, 0xf8, 0x3f, 0xff, 0xff, 0xf8, 0x3f, 0xff, 0xff, 0xf8, 
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  0x00, 0x00, 0x00, 0x00, 0x00, 0x00, 0x00, 0x00, 0x00, 0x00, 0x00, 0x00, 0x00, 0x00, 0x00, 0x00
};

static const char PROGMEM eye3[]={
  0x00, 0x00, 0x00, 0x00, 0x00, 0x00, 0x00, 0x00, 0x00, 0x00, 0x00, 0x00, 0x00, 0x00, 0x00, 0x00, 
  0x00, 0x00, 0x00, 0x00, 0x00, 0x00, 0x00, 0x00, 0x00, 0x00, 0x00, 0x00, 0x00, 0x00, 0x00, 0x00, 
  0x00, 0x00, 0x00, 0x00, 0x00, 0x00, 0x00, 0x00, 0x00, 0x00, 0x00, 0x00, 0x00, 0x00, 0x00, 0x00, 
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  0x00, 0x00, 0x00, 0x00, 0x00, 0x00, 0x00, 0x00, 0x00, 0x00, 0x00, 0x00, 0x00, 0x00, 0x00, 0x00
};

static const char PROGMEM eye4[]={
  0x00, 0x00, 0x00, 0x00, 0x00, 0x00, 0x00, 0x00, 0x00, 0x00, 0x00, 0x00, 0x00, 0x00, 0x00, 0x00, 
  0x00, 0x00, 0x00, 0x00, 0x00, 0x00, 0x00, 0x00, 0x00, 0x00, 0x00, 0x00, 0x00, 0x00, 0x00, 0x00, 
  0x00, 0x00, 0x00, 0x00, 0x00, 0x00, 0x00, 0x00, 0x00, 0x00, 0x00, 0x00, 0x00, 0x00, 0x00, 0x00, 
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  0x00, 0x00, 0x00, 0x00, 0x00, 0x00, 0x00, 0x00, 0x00, 0x00, 0x00, 0x00, 0x00, 0x00, 0x00, 0x00
};

#include <SPI.h>
#include <Wire.h>
#include <Adafruit_GFX.h>
#include <Adafruit_SSD1306.h>

#define SCREEN_WIDTH 128 // OLED display width, in pixels
#define SCREEN_HEIGHT 32 // OLED display height, in pixels

#define EYE_HEIGHT   32
#define EYE_WIDTH    32
#define OLED_RESET     4 
Adafruit_SSD1306 display(SCREEN_WIDTH, SCREEN_HEIGHT, &Wire, OLED_RESET);

void eyePosition(int frame, int delta) {

  char *which;

  switch(frame){
    case 0:
      which = eye;
      break;
    case 1:
      which = eye1;
      break;
    case 2:
      which = eye2;
      break;
    case 3:
      which = eye3;
      break;
    default:
      which = eye4;
      break;
  }
  
  display.clearDisplay();
  
  display.drawBitmap(
   delta+((display.width()  - EYE_WIDTH ) / 2),
   (display.height() - EYE_HEIGHT) / 2,
   which, //Which asset
   EYE_WIDTH,
   EYE_HEIGHT,
  1);
    
   //  display.invertDisplay(true);
  display.display();
}

void eyeTired(int delta, int upset){

  int drop = 10;//((float)(upset / 100)*(EYE_HEIGHT/2));  
  
  eyePosition(0,delta);
  display.fillRect(
    delta+((display.width()  - EYE_WIDTH ) / 2), //x
   (display.height() - EYE_HEIGHT) / 2, //y
   EYE_WIDTH,
   drop,
   0x0
    );
    display.display();
}

void eyeBlink(int delta){
  
  eyePosition(0,delta);
  delay(20);
  eyePosition(1,delta);
  delay(20);
  eyePosition(2,delta);
  delay(20);
  eyePosition(3,delta);
  delay(20);
  eyePosition(4,delta);
  delay(20);  
  eyePosition(3,delta);
  delay(20);
  eyePosition(2,delta);
  delay(20);
  eyePosition(1,delta);
  delay(20);
  eyePosition(0,delta);
  delay(20);  
}

void eyeLookAround(int amp){
  int stp = 3;
  for(int i = 0; i< 360+stp;i+=stp){
    float x = (float)i/360*2*PI ;
    eyePosition(0,amp*sin(x));
    Serial.println( sin(x) );
    delay(10);
  }
}

void setup() {
  Serial.begin(9600); // set the baud rate

  // SSD1306_SWITCHCAPVCC = generate display voltage from 3.3V internally
  if(!display.begin(SSD1306_SWITCHCAPVCC, 0x3C)) { // Address 0x3C for 128x32
    Serial.println(F("SSD1306 allocation failed"));
    for(;;); // Don't proceed, loop forever
  }

  // Show initial display buffer contents on the screen --
  // the library initializes this with an Adafruit splash screen.
  display.display();
  delay(2000); // Pause for 2 seconds
}

void loop() {

//  eyeBlink(0);
//  delay(200);
//  eyeBlink(0);
//  delay(500);
//  eyeBlink(0);
//  delay(2000);
//  eyeLookAround(30);
  delay(1000);
  for (int i = 0;i<1;i++){
    eyeTired(0,i);
    delay(500);
  }
  
//  char inByte = ' ';
//  if(Serial.available()){ // only send data back if data has been sent
//    char inByte = Serial.read(); // read the incoming data
//    Serial.println(inByte); // send the data back in a new line so that it is not all one long line
//  }
//  delay(100); // delay for 1/10 of a second
}
